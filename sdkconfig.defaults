## sdkconfig.defaults
```kconfig
# Target
CONFIG_IDF_TARGET="esp32s3"

# Flash (16MB QIO)
CONFIG_ESPTOOLPY_FLASHSIZE_16MB=y
CONFIG_ESPTOOLPY_FLASHMODE_QIO=y
CONFIG_ESPTOOLPY_FLASHFREQ_80M=y

# PSRAM (ESP32-S3-WROOM-1U-N16R8: 8MB Octal PSRAM)
CONFIG_SPIRAM=y
CONFIG_SPIRAM_MODE_OCT=y
CONFIG_SPIRAM_SPEED_80M=y
CONFIG_SPIRAM_USE_MALLOC=y
CONFIG_SPIRAM_MALLOC_ALWAYSINTERNAL=16384
CONFIG_SPIRAM_MALLOC_RESERVE_INTERNAL=32768

# CPU
CONFIG_ESP_DEFAULT_CPU_FREQ_MHZ_240=y

# WiFi
CONFIG_ESP_WIFI_ENABLED=y
CONFIG_ESP_WIFI_NVS_ENABLED=y

# Partition table
CONFIG_PARTITION_TABLE_CUSTOM=y
CONFIG_PARTITION_TABLE_CUSTOM_FILENAME="partitions.csv"

# FreeRTOS
CONFIG_FREERTOS_HZ=1000

# LWIP sockets
CONFIG_LWIP_MAX_SOCKETS=16

# USB Serial/JTAG console
CONFIG_ESP_CONSOLE_USB_SERIAL_JTAG=y

# Compiler optimization
CONFIG_COMPILER_OPTIMIZATION_PERF=y

# HTTP Client (HTTPS for AI API)
CONFIG_ESP_HTTP_CLIENT_ENABLE_HTTPS=y
```
